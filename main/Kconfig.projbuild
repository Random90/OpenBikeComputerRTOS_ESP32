## main/Kconfig.projbuild
```kconfig
menu "OBC Configuration"
    menu "Basic"
        config WHEEL_CIRCUMFERENCE
            int "Wheel circumference in mm"
            default 2012
            help
                Set your wheel circumference in milimeters measured with tyre.
    endmenu

    menu "WiFi"
        config ESP_WIFI_SSID
            string "WiFi SSID"
            default "myssid"
            help
                SSID (network name) for the example to connect to.

        config ESP_WIFI_PASSWORD
            string "WiFi Password"
            default "mypassword"
            help
                WiFi password (WPA or WPA2) for the example to use.

        config ESP_MAXIMUM_RETRY
            int "Maximum retry"
            default 5
            help
                Set the Maximum retry to avoid station reconnecting to the AP unlimited when the AP is really inexistent.
    endmenu

    menu "Synchronization"
        config OBC_SERVER_ADDR
            string "OBC Sync Server Root Address"
            default "malina9.ddns.net"
            help
                Address of synchronization server to which ride data will be sent after each ride, if WiFi is connected.
                
        config OBC_SERVER_PORT
            int "OBC Sync Server Port"
            default "8000"
            help
               Port of synchronization server to which ride data will be sent after each ride, if WiFi is connected. 
    endmenu

endmenu
```
